## boards/shields/hileud/Kconfig.shield
```kconfig
# Copyright (c) 2022 The ZMK Contributors
# SPDX-License-Identifier: MIT

config SHIELD_HILEUD_LEFT
    def_bool $(shields_list_contains,hileud_left)

config SHIELD_HILEUD_RIGHT
    def_bool $(shields_list_contains,hileud_right)
```
